// SPDX-License-Identifier: (GPL-2.0+ OR MIT)
/*
 * sama5d3_eds_rmii_c22.dtso - Device Tree file for SAMA5D3 EDS board
 * overlay blob for a generic RMII phy (clause 22) add-on board.
 *
 * Copyright (C) 2025 Microchip Technology Inc. and its subsidiaries
 *
 * Author: Joemel John A. Diente <joemeljohn.diente@microchip.com>
 *
 */
/dts-v1/;
/plugin/;

#include "dt-bindings/interrupt-controller/irq.h"
#include "dt-bindings/pinctrl/at91.h"

&macb1 {
	phy-mode = "rmii";
	phy-handle = <&mbitphy>;
	max-speed = <100>;
	status = "okay";

	mdio {
		#address-cells = <1>;
		#size-cells = <0>;

		mbitphy: ethernet-phy@0 {
			compatible = "ethernet-phy-ieee802.3-c22";
			reg = <0x0>; 
			max-speed = <100>;
			status = "okay";
		};
	};
};

&{/} {
	model = "SAMA5D3-EDS: Generic Clause 22 PHY in RMII";
};
