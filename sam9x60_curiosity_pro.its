## sam9x60_curiosity_pro.its
```
// SPDX-License-Identifier: (GPL-2.0+ OR MIT)
/*
 * Flattened Image Tree file for SAM9X60 Curiosity Pro board
 *
 * Copyright (C) 2026 Microchip Technology Inc. and its subsidiaries
 *
 * Author: Manikandan Muralidharan <manikandan.m@microchip.com>
 */
/dts-v1/;

/ {
	description = "Microchip SAM9X60-Curiosity-Pro FIT Image";
	#address-cells = <1>;

	images {
		kernel {
			description = "Linux4SAM Linux kernel";
			data = /incbin/("./zImage");
			type = "kernel";
			arch = "arm";
			os = "linux";
			compression = "none";
			load = <0x22000000>;
			entry = <0x22000000>;
			hash {
				algo = "sha256";
			};
		};

		base_fdt {
			description = "SAM9X60-Curiosity-Pro Flattened Device Tree blob";
			data = /incbin/("./at91-sam9x60_curiosity_pro.dtb");
			type = "flat_dt";
			arch = "arm";
			compression = "none";
			load = <0x23000000>;
			hash {
				algo = "sha256";
			};
		};

		fdt_macb0_rmii_phy {
			description = "Device Tree blob for EMAC0 RMII PHY overlay";
			data = /incbin/("./sam9x60_curiosity_pro/sam9x60_curiosity_pro_macb0_rmii-phy.dtbo");
			type = "flat_dt";
			arch = "arm";
			compression = "none";
			load = <0x23100000>;
			hash {
				algo = "sha256";
			};
		};

		fdt_pda5 {
			description = "Device Tree blob for PDA5000 LCD overlay";
			data = /incbin/("./sam9x60_curiosity_pro/sam9x60_curiosity_pro_pda5.dtbo");
			type = "flat_dt";
			arch = "arm";
			compression = "none";
			load = <0x23200000>;
			hash {
				algo = "sha256";
			};
		};
	};

	configurations {
		default = "kernel_dtb";

		kernel_dtb {
			description = "Linux kernel and base FDT blob for SAM9X60-Curiosity-Pro board";
			kernel = "kernel";
			fdt = "base_fdt";
		};

		base_dtb {
			description = "Base FDT blob for SAM9X60-Curiosity-Pro board";
			fdt = "base_fdt";
		};

		rmii_phy {
			description = "FDT overlay blob for EMAC0 RMII PHY";
			fdt = "fdt_macb0_rmii_phy";
		};

		pda5 {
			description = "FDT overlay blob for PDA5000 LCD";
			fdt = "fdt_pda5";
		};
	};
};
```
